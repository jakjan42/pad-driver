/dts-v1/;
/plugin/;
/ {
	compatible = "allwinner,sun50i-h616-i2c\0allwinner,sun8i-v536-i2c\0allwinner,sun6i-a31-i2c";
	fragment@0 {
		target = <&i2c1>;
		__overlay__ {
			#address-cells = <1>;
			#size-cells = <0>;

			ospad: ospad@67 {
				compatible = "p560,ospad";
				reg = <0x67>;
				status = "okay";
			};
		};
	};
};
